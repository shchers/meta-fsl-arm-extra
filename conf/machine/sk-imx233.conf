## conf/machine/sk-imx233.conf
```bitbake
#@TYPE: Machine
#@NAME: Starterkit SK-i.MX233
#@SOC: i.MX23
#@DESCRIPTION: Machine configuration for Starterkit SK-i.MX233 board

require conf/machine/include/imx-base.inc
require conf/machine/include/tune-arm926ejs.inc

SOC_FAMILY = "mxs:mx23:sk-imx233"

IMXBOOTLETS_MACHINE = "stmp378x_dev"

PREFERRED_PROVIDER_u-boot = "u-boot-shchers"
PREFERRED_PROVIDER_virtual/bootloader = "u-boot-shchers"
UBOOT_MACHINE = "mx23_sk_defconfig"

PREFERRED_PROVIDER_virtual/kernel = "linux-shchers"
KERNEL_IMAGETYPE = "zImage"
KERNEL_DEVICETREE = "imx23-sk.dtb"

MACHINE_FEATURES = "usbgadget usbhost vfat"

MACHINE_ESSENTIAL_EXTRA_RDEPENDS += "\
	kernel-image kernel-devicetree \
	net-persistent-mac \
"

# See image_types_fsl.bbclass for details
IMAGE_FSTYPES = "uboot.mxsboot-sdcard sdcard.gz tar.bz2"
```
